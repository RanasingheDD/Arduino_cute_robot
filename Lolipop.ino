#include <Wire.h>
#include <Adafruit_GFX.h>
#include <Adafruit_SSD1306.h>

#define SCREEN_WIDTH 128
#define SCREEN_HEIGHT 64
const int touchPin = 13;
int count = 0;
unsigned long firstTouchTime = 0;
const unsigned long timeWindow = 2000;
unsigned long previousMillis = 0;
unsigned long blinkInterval = 0;

Adafruit_SSD1306 display(SCREEN_WIDTH, SCREEN_HEIGHT, &Wire, -1);


static const unsigned char PROGMEM image_data_DISTRESSED_EYESarray[] = { 
  // ARRAY for DISTRESSED_EYES
  0x00, 0x00, 0x00, 0x00, 0x00, 0x00, 0x00, 0x00, 0x00, 0x00, 0x00, 0x00, 0x00, 0x00, 0x00, 0x00, 
  0x00, 0x00, 0x00, 0x00, 0x00, 0x00, 0x00, 0x00, 0x00, 0x00, 0x00, 0x00, 0x00, 0x00, 0x00, 0x00, 
  0x00, 0x00, 0x00, 0x00, 0x00, 0x00, 0x00, 0x00, 0x00, 0x00, 0x00, 0x00, 0x00, 0x00, 0x00, 0x00, 
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  0x00, 0x00, 0x00, 0x00, 0x00, 0x00, 0x00, 0x00, 0x00, 0x00, 0x00, 0x00, 0x00, 0x00, 0x00, 0x00,   
};

static const unsigned char PROGMEM image_data_EYES_FRONTarray[] = { 
  // ARRAY for 2nd Array EYES_FRONT 
  0x00, 0x00, 0x00, 0x00, 0x00, 0x00, 0x00, 0x00, 0x00, 0x00, 0x00, 0x00, 0x00, 0x00, 0x00, 0x00, 
  0x00, 0x00, 0x00, 0x00, 0x00, 0x00, 0x00, 0x00, 0x00, 0x00, 0x00, 0x00, 0x00, 0x00, 0x00, 0x00, 
  0x00, 0x00, 0x00, 0x00, 0x00, 0x00, 0x00, 0x00, 0x00, 0x00, 0x00, 0x00, 0x00, 0x00, 0x00, 0x00, 
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  0x00, 0x00, 0x00, 0x00, 0x00, 0x00, 0x00, 0x00, 0x00, 0x00, 0x00, 0x00, 0x00, 0x00, 0x00, 0x00, 
};

static const unsigned char PROGMEM image_data_EYES_ANGRYarray[] = {
  0x00, 0x00, 0x00, 0x00, 0x00, 0x00, 0x00, 0x00, 0x00, 0x00, 0x00, 0x00, 0x00, 0x00, 0x00, 0x00, 
  0x00, 0x00, 0x00, 0x00, 0x00, 0x00, 0x00, 0x00, 0x00, 0x00, 0x00, 0x00, 0x00, 0x00, 0x00, 0x00, 
  0x00, 0x00, 0x00, 0x00, 0x00, 0x00, 0x00, 0x00, 0x00, 0x00, 0x00, 0x00, 0x00, 0x00, 0x00, 0x00, 
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  0x00, 0x00, 0x00, 0x00, 0x00, 0x00, 0x00, 0x00, 0x00, 0x00, 0x00, 0x00, 0x00, 0x00, 0x00, 0x00,
};

void eyeblink(){
  for(int16_t i=0; i<30; i+=5) {
    display.fillRect(0, 0, 132, 10+i, BLACK);  
    display.display();
    delay(1);
    }
  }

void setup() {
  Serial.begin(9600);
   if(!display.begin(SSD1306_SWITCHCAPVCC, 0x3C)) {
    Serial.println(F("SSD1306 allocation failed"));
    for(;;);
  }

  display.clearDisplay();

  pinMode(touchPin, INPUT);
  display.setTextSize(2);
  display.setTextColor(SSD1306_WHITE);
  display.setCursor(0,0);
  display.println(F("Hello"));
  display.println();
  display.setTextSize(2);
  display.println(F("I'am Lolipop"));
  display.display();
  delay(2000);

  display.clearDisplay(); 
 
  randomSeed(analogRead(0));

  blinkInterval = random(2000, 10000); 

}

void loop() {

  int touchState = digitalRead(touchPin);
  unsigned long currentTime = millis();

  if (touchState == HIGH) {
    Serial.println("Touched");

    if (count == 0) {
      firstTouchTime = currentTime;
    }

    count++;
    delay(100);
  } else {
    Serial.println("Not Touched");
  }

  if (count >= 2 && (currentTime - firstTouchTime) <= timeWindow) {
    display.drawBitmap(0, 0, image_data_EYES_ANGRYarray, 128, 64, 1);
    display.display();
    count = 0;
    delay(2000);
    display.drawBitmap(0, 0, image_data_DISTRESSED_EYESarray, 128, 64, 1);
    display.display();
    delay(1000);
    display.clearDisplay();

    count = 0;
    firstTouchTime = 0;
  } else if ((currentTime - firstTouchTime) > timeWindow) {
    count = 0;
    firstTouchTime = 0;
  }
  delay(100);
  display.clearDisplay();  

  unsigned long currentMillis = millis();

  if (currentMillis - previousMillis >= blinkInterval) {
    previousMillis = currentMillis;
    
    eyeblink();
    
    blinkInterval = random(2000, 10000); 
  }
  display.drawBitmap(0, 0, image_data_EYES_FRONTarray, 128, 64, 1);
  display.display();


  display.display();
  delay(1000); 
  display.clearDisplay();  

  Serial.println(count);

}